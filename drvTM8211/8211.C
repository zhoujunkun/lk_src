//-----------------------------------------------------
//测试项目:16位数字模拟转换器TM8211芯片测试
//测试内容:输出相位平移的正弦波
//测试单片机:STC12C5608AD
//晶振:36MHZ

//-----------------------------------------------------
#include<reg52.H>
#include<intrins.h>
//-----------------------------------------------------
#define uint unsigned int 
#define uchar unsigned char 
//-----------------------------------------------------
sbit BCK=P2^1;
sbit WS=P2^0;
sbit DIN=P1^7;

//======================================================
int *intR;
int *intL;

//======================================================
int code tab16[]={

0, 		   //*32767
1029, 
2057,
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-2057, 
-1029 	
};
//======================================================
//     	写入16位数据
 void write_16bit(uint temp)
{
	uchar i;
	DIN=0;
	BCK=0;
	for(i=0;i<16;i++)
	{
		 BCK=0;
		 if(temp&0x8000)
		   DIN=1;
		 else
		   DIN=0;
		 BCK=1;
		 temp<<=1;	 
	}
}

//------------------------------------------------------------------
void delay(uint z)		   //1us延时子程序
{
	uint x,y;
	for(x=z;x>0;x--)
		for(y=112;y>0;y--);
}
//=======================================================
void delay1us(uint z)
{
	while(z--);
}
//=======================================================

void main()
{	
	int j1,j2;
    uchar phase=0;
	WS=0;

	while(1)
	{
		intL=tab16;
		j2=0;
		for(j1=0;j1<200;j1++)
		{		
		        intL=tab16+j1;
		        WS=1;					 //LCH输出
				write_16bit((*intL));  
				
				j2=(j1+phase)%200;
			
				intR=tab16+j2;
				WS=0;					 //RCH输出
				write_16bit(*(intR));
		
		}
	  phase++;
	  if(phase>=200)
	  phase=0;
	
	}
}

