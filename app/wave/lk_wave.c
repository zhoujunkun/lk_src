/**
  ******************************************************************************
  * @file           : lk_wave.c
  * @author         : zjk
  * @version        : v1.0
  * @date           : 2020-1-3
  * @brief          : 中频波形实现
  ******************************************************************************
  */
#include "lk_wave.h"
int arraySize=128;
#include "lk_pwmDac.h"

lk_waveParam_t waveHandle =
{
  .freq=10,  //10HZ
  .gears=1,
  .select=0,
};
/*tm8211 wave data*/
 #if ENABLE_TM8211
int index_min=33;//最小值位置
int tm8211_diff=21845;//相差值
int waveArray[]={ //波形数组 
0,-1620,-3237,-4845,-6442,-8023,-9584,-11122,-12633,-14113,
-15558,-16965,-18331,-19651,-20924,-22145,-23313,-24423,-25473,-26461,
-27385,-28241,-29028,-29744,-30388,-30957,-31450,-31866,-32205,-32464,
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11122,9584,8023,6442,4845,3237,1620,0,};
#endif

/*pwm dac wave data*/

#define SAMPLE_N	128
const uint16_t bwavefile[][SAMPLE_N] ={
{0,0,1,1,2,4,6,8,10,12,15,18,22,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0,0},
{0,0,0,0,0,0,0,0,0,1,1,1,1,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244,255},
{0,0,0,0,0,1,1,1,1,1,1,1,2,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246,255},
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{0,0,0,0,0,0,0,0,0,0,0,0,0,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0,0},
};


uint8_t myGears=1;
/**************************************************************************************************
 * @fn void wave_select(uint8_t gears)
 *
 * @brief  配置档位
 * input parameters
 *
 * @gears: 档位 1~15
 * @R: 写入RCH数据
 * output parameters
 * @return      None.
 */
void wave_gearSelect(uint8_t gears)
{  
  if(gears >=15) gears=15;
  if(gears ==0) gears=1;
   myGears = gears;
}

int arrayCnt=0;
/**************************************************************************************************
 * @fn void wave_1ms_callback(void)
 *
 * @brief   
 * input parameters
 *
 * @uint8_t waveNums: 波形选择
 * @R: 写入RCH数据
 * output parameters
 * @return      None.
 */
int offdet=17; //255/15
int wave_1ms_callback(lk_waveParam_t *waveCfg)
{ 
  static uint16_t index=0;
  #if ENABLE_TM8211 
	tm8211_writeSingle(waveArray[index_min],waveArray[arrayCnt++]/myGears);
  if(arrayCnt >= arraySize) arrayCnt=0;
	#endif
	uint16_t waveArray=0;
	if(waveCfg->gears >=15) waveCfg->gears=15;
  #if ENABLE_PWM_DAC
    if (waveCfg ==NULL)
    {
			waveArray = bwavefile[waveHandle.select][index++]/15*waveHandle.gears;
       pwmSet_compare(waveArray);
       if(index >= SAMPLE_N) index=0;
    }
    else
    {
				waveArray = bwavefile[waveCfg->select][index++]/15*waveCfg->gears;
       pwmSet_compare(waveArray);
       if(index >= SAMPLE_N) index=0;
    }
    

  #endif
  return 1;
}

//测试函数
void wave_example(void)
{
    //tm8211_write(NULL,&tm8211_R);
}