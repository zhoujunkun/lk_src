/*****************************************************************************
*   adc.c:  source file for adc module
*		ver 1.1 add suuport  to 8~11
******************************************************************************/

#include "CMSDK_CM0.h"
#include "sys.h"
#include "adc.h"

extern uint32_t SystemCoreClock;

/*****************************************************************************
Function Name	ADC_Init
Function Definition	void ADC_Init(uint32_t conversionrate)
Function Description	Initial ADC module
Input Parameters	Conversionrate: conversion rate, must less 1000000 (1MHz)
Return Value	No
Condition	No
Function called	-

*****************************************************************************/
void ADC_Init(uint32_t conversionrate)
{
	uint32_t temp,div;

	//Power up ADC
	(*SYSCON).PDRUNCFG_b.ADC_PD = 0;
	
	//enable clock of ADC digital
	(*SYSCON).SYSAHBCLKCTRL_b.ADC_CLK = 1;

	//reset ADC digital
	(*SYSCON).PRESETCTRL_b.ADC_RST_N = 0;
	(*SYSCON).PRESETCTRL_b.ADC_RST_N = 1;

	//limit convertion rate to 1M/s
	if (conversionrate>1000000)
		conversionrate = 1000000;
	conversionrate=conversionrate<<4;
	
	//caculate clk divider
	div = SystemCoreClock/conversionrate;

	if (((div*conversionrate)!=SystemCoreClock)&&(SystemCoreClock>16000000*div))
		div++;
	
	//set up divider
	(*ADC).CR_b.CLKDIV = div;
	
	//insert a delay
	temp=0xff;
	while (temp--);
	
	//select external sample clk
	(*ADC).CR_b.SCMODE=0;
	(*ADC).CR_b.SCMODE=1;
	
	//wait untile adc ready
	while((*ADC).STAT_b.ADCRDY ==0);

	return;
}
/*****************************************************************************
Function Name	ADC_DeInit
Function Definition	Void ADC_DeInit(viod)
Function Description	De_Initial ADC module. Disable interrupt generated by module and stop any conversion.
Input Parameters	No
Return Value	No
Condition	No
Function called	-

*****************************************************************************/
void ADC_DeInit(void)
{
	
	ADC->INTEN=0;
	//ADC->STAT = 0xFFFFFFFF;
	//Power down ADC
	(*SYSCON).PDRUNCFG_b.ADC_PD = 1;
	//disable clock of ADC digital
	(*SYSCON).SYSAHBCLKCTRL_b.ADC_CLK = 0;

	return;
}
/*****************************************************************************
Function Name	ADC_SetupChannels
Function Definition	Void ADC_SetupChannels (uint32_t channelassign, uint32_t triggermode)
Function Description	Select AD channels to be converted and AD conversion trigger mode
Input Parameters		channelassign: AD channel and DR assignment. Ref CHSEL register description. 
										Example (AD1<<ADC_DR0SEL)|(AD2<<ADC_DR0SEL), channel AD1 conversion value will be in DR1, and channel AD2 conversion value will be in DR4. DRncan not be duplicated.
										triggermode;	BURSTMODE/TRIGGERMODE
Return Value	No
Condition	No
Function called	-

*****************************************************************************/
void ADC_SetupChannels (uint32_t channelassign, uint32_t triggermode)
{
	uint32_t i;
	uint32_t temp;
	uint32_t adcchannel=0;
	
	//setup DR conversion enable
	for (i=0;i<32;i=i+4)
	{
		temp = (channelassign & (0xF<<i))>>i;
		if (temp!=0)
		{
			if (temp==0xF)
				temp=0;

			if (temp<12)
			adcchannel |= temp<<i;
			
			ADC->CR_b.CNVEN |= 1<<(i/4);								
		}		
	}
	
	//Setup channel
	(*ADC).CHSEL = adcchannel;
	
	//Select burst mode or triggermode
	if (triggermode == BURSTMODE)
	{
		(*ADC).CR_b.START=0;
		//select external sample clk
		(*ADC).CR_b.SCMODE=0;
		(*ADC).CR_b.SCMODE=1;
	}
	(*ADC).CR_b.BURST = triggermode;
	//setup DR conversion enable
	
	if (triggermode==TRIGGERMODE)
	{
		//wait untile adc ready
		while(!ADC->STAT_b.ADCRDY );		
	}
	return;
}
/*****************************************************************************
Function Name	ADC_SetTrigger
Function Definition	Void ADC_SetTrigger(uint8_t triggersrc, uint8_t edge)
Function Description	Setup trigger source signal if ADC is in trigger mode
Input Parameters	Triggersrc: select one option
										ADC_START_BY_SOFTWAER, 
										ADC_START_BY_TIM6_CAP0, 
										ADC_START_BY_TIM6_CAP1, 
										ADC_START_BY_TIM6_MAT0,
										ADC_START_BY_TIM6_MAT1,
										ADC_START_BY_TIM7_MAT0,
										ADC_START_BY_TIM7_MAT1,
										ADC_START_BY_PWM
Return Value	No
Condition	No
Function called	-

*****************************************************************************/
void ADC_SetTrigger(uint8_t triggersrc, uint8_t edge)
{
	//set up ADC start mode 
	(*ADC).CR_b.START = triggersrc;
	(*ADC).CR_b.EDGE	= edge;
	
	while(!ADC->STAT_b.ADCRDY );	
	
	return;
}
/*****************************************************************************
Function Name	ADC_SetHighCmp0
Function Definition	void ADC_SetHighCmp0(uint32_t val, uint8_t selchannel)
Function Description	Setup high limit register 0 value and channel to be compare
Input Parameters	val: 	high limit value
									selchannel: one of AD0~AD7
Return Value	No
Condition	No
Function called	-

*****************************************************************************/
void ADC_SetHighCmp0(uint32_t val, uint8_t selchannel)
{
	(*ADC).HILMT_b.HILMT0 = val;
	if (selchannel==AD0)
		selchannel=0;
	(*ADC).HILMT_b.CHNSEL0 = selchannel;
	return;
}
/*****************************************************************************
Function Name	ADC_SetHighCmp1
Function Definition	void ADC_SetHighCmp1(uint32_t val, uint8_t selchannel)
Function Description	Setup high limit register 1 value and channel to be compare
Input Parameters		val: high limit value
										selchannel: one of AD0~AD7
Return Value	No
Condition	No
Function called	-

*****************************************************************************/
void ADC_SetHighCmp1(uint32_t val, uint8_t selchannel)
{
	(*ADC).HILMT_b.HILMT1 = val;
	if (selchannel==AD0)
		selchannel=0;
	(*ADC).HILMT_b.CHNSEL1 = selchannel;
	return;
}
	
/*****************************************************************************
Function Name	ADC_SetLowCmp0
Function Definition	void ADC_SetLowCmp0(uint32_t val, uint8_t selchannel)
Function Description	Setup low limit register 0 value and channel to be compare
Input Parameters		val: high limit value
										selchannel: one of AD0~AD11
Return Value	No
Condition	No
Function called	-

*****************************************************************************/
void ADC_SetLowCmp0(uint32_t val, uint8_t selchannel)
{
	(*ADC).LOLMT_b.LOLMT0 = val;
	if (selchannel==AD0)
		selchannel=0;
	(*ADC).LOLMT_b.CHNSEL0 = selchannel;
	return;
}
/*****************************************************************************
Function Name	ADC_SetLowCmp1
Function Definition	void ADC_SetLowCmp1(uint32_t val, uint8_t selchannel)
Function Description	Setup low limit register 1 value and channel to be compare
Input Parameters			val: high limit value
											selchannel: one of AD0~AD7
Return Value	No
Condition	No
Function called	-

*****************************************************************************/
void ADC_SetLowCmp1(uint32_t val, uint8_t selchannel)
{
	(*ADC).LOLMT_b.LOLMT1 = val;
	if (selchannel==AD0)
		selchannel=0;
	(*ADC).LOLMT_b.CHNSEL1 = selchannel;
	return;
}
/*****************************************************************************
Function Name	ADC_EnableConversionInt
Function Definition	Void ADC_EnableConversionInt(uint32_t inttype)
Function Description	Setup conversion completed interrupt
Input Parameters		inttype: combination of interrupt source-
										bit 0~7 related to ADC_DR0~ ADC_DR7 value updated
										bit 8 related ADC global register updated
Return Value	No
Condition	No
Function called	-

*****************************************************************************/
void ADC_EnableConversionInt(uint32_t inttype)
{
	(*ADC).INTEN =  inttype;
	return;
}
/*****************************************************************************
Function Name	ADC_GetConversionData
Function Definition	uint32_t ADC_GetConversionData(uint8_t dr)
Function Description	Read conversion data 
Input Parameters	dr: data register ADC_DR0~ ADC_DR7
Return Value	Conversion value. If no new value, return 0xFFFF FFFF. GDR value bit 14:12 value represent ADC channel 0~11
Condition	No
Function called	-

*****************************************************************************/
uint32_t ADC_GetConversionData(uint8_t dr)
{
	uint32_t DRvalue;
	do
	{
		DRvalue = *(&(ADC->DR0)+(uint32_t)(dr));
	}while(( DRvalue & 0x80000000) == 0);
		
	return DRvalue&0xFFF;
}


/******************************************************************************
**                            End Of File
******************************************************************************/
